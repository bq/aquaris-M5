## drivers/input/touchscreen/atmel/Kconfig
```kconfig
config TOUCHSCREEN_ATMEL_MXTS
        bool "Atmel mxts touchscreen"
        default n
        help
          Say Y here if you have a atmel mxts touchscreen interfaced
          to the host processor over I2C

          If unsure, say N.
```

## drivers/input/touchscreen/mms200/Kconfig
```kconfig
#
# Touchscreen driver configuration
#

if INPUT_TOUCHSCREEN

config TOUCHSCREEN_MMS200
        tristate "MELFAS MMS200 Touchscreen"
        depends on I2C
        help
          Say Y here if you have a MELFAS MMS200 touchscreen device in your system.

          If unsure, say N.

          To compile this driver as a module, choose M here: the module will be called mms_ts.

endif
```

## drivers/input/touchscreen/tpinfo/Kconfig
```kconfig
config TOUCHSCREEN_TP_INFO
        bool "TPInfo touchscreen"
        default n
        help
          Say Y here if you have a TP Info module

          If unsure, say N.
```
