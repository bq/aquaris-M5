/* Copyright (c) 2013, The Linux Foundation. All rights reserved.
 *
 * This program is free software; you can redistribute it and/or modify
 * it under the terms of the GNU General Public License version 2 and
 * only version 2 as published by the Free Software Foundation.
 *
 * This program is distributed in the hope that it will be useful,
 * but WITHOUT ANY WARRANTY; without even the implied warranty of
 * MERCHANTABILITY or FITNESS FOR A PARTICULAR PURPOSE.  See the
 * GNU General Public License for more details.
 */

/*---------------------------------------------------------------------------
 * This file is autogenerated file using gcdb parser. Please do not edit it.
 * Update input XML file to add a new entry or update variable in this file
 * VERSION = "1.0"
 *---------------------------------------------------------------------------*/
&mdss_mdp {
	dsi_truly_nt35695_1080p_video_vid: qcom,mdss_dsi_truly_nt35695_1080p_video {
		qcom,mdss-dsi-panel-name = "TRULY NT35695 1080P video mode dsi panel";
		qcom,mdss-dsi-panel-controller = <&mdss_dsi0>;
		qcom,mdss-dsi-panel-type = "dsi_video_mode";
		qcom,mdss-dsi-panel-destination = "display_1";
		qcom,cont-splash-enabled;
		qcom,mdss-dsi-panel-framerate = <60>;
		qcom,mdss-dsi-virtual-channel-id = <0>;
		qcom,mdss-dsi-stream = <0>;
		qcom,mdss-dsi-panel-width = <1080>;
		qcom,mdss-dsi-panel-height = <1920>;
		qcom,mdss-dsi-h-front-porch = <90>;
		qcom,mdss-dsi-h-back-porch = <60>;
		qcom,mdss-dsi-h-pulse-width = <20>;
		qcom,mdss-dsi-h-sync-skew = <0>;
		qcom,mdss-dsi-v-front-porch = <9>;
		qcom,mdss-dsi-v-back-porch = <2>;
		qcom,mdss-dsi-v-pulse-width = <2>;
		qcom,mdss-dsi-h-left-border = <0>;
		qcom,mdss-dsi-h-right-border = <0>;
		qcom,mdss-dsi-v-top-border = <0>;
		qcom,mdss-dsi-v-bottom-border = <0>;
		qcom,mdss-dsi-bpp = <24>;
		qcom,mdss-dsi-color-order = "rgb_swap_rgb";
		qcom,mdss-dsi-underflow-color = <0xff>;
		qcom,mdss-dsi-border-color = <0>;
		qcom,mdss-pan-physical-width-dimension = <62>; //the panel physical size : refer to datasheet
		qcom,mdss-pan-physical-height-dimension = <110>;
		qcom,mdss-dsi-on-command = [
			39 01 00 00 01 00 02
			FF 20
			39 01 00 00 00 00 02
			FB 01 
			39 01 00 00 00 00 02
			00 01  
			39 01 00 00 00 00 02
			01 55 
			39 01 00 00 00 00 02
			02 45 
			39 01 00 00 00 00 02
			03 55 
			39 01 00 00 00 00 02
			05 50 
			39 01 00 00 00 00 02
			04 00 
			39 01 00 00 00 00 02
			06 9E 
			39 01 00 00 00 00 02
			07 A8 
			39 01 00 00 00 00 02
			08 0C 
			39 01 00 00 00 00 02
			09 73 
			39 01 00 00 00 00 02
			0A 73 
			39 01 00 00 00 00 02
			0D 00 
			39 01 00 00 00 00 02
			0B 96 
			39 01 00 00 00 00 02
			0C 96 
			39 01 00 00 00 00 02
			0E 00 
			39 01 00 00 00 00 02
			0F 00 
			39 01 00 00 00 00 02
			11 27 
			39 01 00 00 00 00 02
			12 63 
			39 01 00 00 00 00 02
			13 F3 
			39 01 00 00 00 00 02
			14 4A 
			39 01 00 00 00 00 02
			15 93 
			39 01 00 00 00 00 02
			16 93 
			39 01 00 00 00 00 02
			17 63 
			39 01 00 00 00 00 02
			18 63 
			39 01 00 00 00 00 02
			19 63 
			39 01 00 00 00 00 02
			1A 63 
			39 01 00 00 00 00 02
			68 03 
			39 01 00 00 00 00 02
			69 A0 
			39 01 00 00 00 00 02
			6A 33 
			39 01 00 00 00 00 02
			6B 40 
			39 01 00 00 00 00 02
			6C 33 
			39 01 00 00 00 00 02
			6D 68 
			39 01 00 00 00 00 02
			75 00 
			39 01 00 00 00 00 02
			76 00 
			39 01 00 00 00 00 02
			77 00 
			39 01 00 00 00 00 02
			78 22 
			39 01 00 00 00 00 02
			79 00 
			39 01 00 00 00 00 02
			7A 46 
			39 01 00 00 00 00 02
			7B 00 
			39 01 00 00 00 00 02
			7C 5C 
			39 01 00 00 00 00 02
			7D 00 
			39 01 00 00 00 00 02
			7E 76 
			39 01 00 00 00 00 02
			7F 00 
			39 01 00 00 00 00 02
			80 8D 
			39 01 00 00 00 00 02
			81 00 
			39 01 00 00 00 00 02
			82 A6 
			39 01 00 00 00 00 02
			83 00 
			39 01 00 00 00 00 02
			84 B8 
			39 01 00 00 00 00 02
			85 00 
			39 01 00 00 00 00 02
			86 C7 
			39 01 00 00 00 00 02
			87 00 
			39 01 00 00 00 00 02
			88 F6 
			39 01 00 00 00 00 02
			89 01 
			39 01 00 00 00 00 02
			8A 1D 
			39 01 00 00 00 00 02
			8B 01 
			39 01 00 00 00 00 02
			8C 54 
			39 01 00 00 00 00 02
			8D 01 
			39 01 00 00 00 00 02
			8E 81 
			39 01 00 00 00 00 02
			8F 01 
			39 01 00 00 00 00 02
			90 CB 
			39 01 00 00 00 00 02
			91 02 
			39 01 00 00 00 00 02
			92 05 
			39 01 00 00 00 00 02
			93 02 
			39 01 00 00 00 00 02
			94 07 
			39 01 00 00 00 00 02
			95 02 
			39 01 00 00 00 00 02
			96 47 
			39 01 00 00 00 00 02
			97 02 
			39 01 00 00 00 00 02
			98 82 
			39 01 00 00 00 00 02
			99 02 
			39 01 00 00 00 00 02
			9A AB 
			39 01 00 00 00 00 02
			9B 02 
			39 01 00 00 00 00 02
			9C DC 
			39 01 00 00 00 00 02
			9D 03 
			39 01 00 00 00 00 02
			9E 01 
			39 01 00 00 00 00 02
			9F 03 
			39 01 00 00 00 00 02
			A0 3A 
			39 01 00 00 00 00 02
			A2 03 
			39 01 00 00 00 00 02
			A3 56 
			39 01 00 00 00 00 02
			A4 03 
			39 01 00 00 00 00 02
			A5 6D 
			39 01 00 00 00 00 02
			A6 03 
			39 01 00 00 00 00 02
			A7 89 
			39 01 00 00 00 00 02
			A9 03 
			39 01 00 00 00 00 02
			AA A3 
			39 01 00 00 00 00 02
			AB 03 
			39 01 00 00 00 00 02
			AC C9 
			39 01 00 00 00 00 02
			AD 03 
			39 01 00 00 00 00 02
			AE DD 
			39 01 00 00 00 00 02
			AF 03 
			39 01 00 00 00 00 02
			B0 F5 
			39 01 00 00 00 00 02
			B1 03 
			39 01 00 00 00 00 02
			B2 FF 
			39 01 00 00 00 00 02
			B3 00 
			39 01 00 00 00 00 02
			B4 00 
			39 01 00 00 00 00 02
			B5 00 
			39 01 00 00 00 00 02
			B6 22 
			39 01 00 00 00 00 02
			B7 00 
			39 01 00 00 00 00 02
			B8 46 
			39 01 00 00 00 00 02
			B9 00 
			39 01 00 00 00 00 02
			BA 5C 
			39 01 00 00 00 00 02
			BB 00 
			39 01 00 00 00 00 02
			BC 76 
			39 01 00 00 00 00 02
			BD 00 
			39 01 00 00 00 00 02
			BE 8D 
			39 01 00 00 00 00 02
			BF 00 
			39 01 00 00 00 00 02
			C0 A6 
			39 01 00 00 00 00 02
			C1 00 
			39 01 00 00 00 00 02
			C2 B8 
			39 01 00 00 00 00 02
			C3 00 
			39 01 00 00 00 00 02
			C4 C7 
			39 01 00 00 00 00 02
			C5 00 
			39 01 00 00 00 00 02
			C6 F6 
			39 01 00 00 00 00 02
			C7 01 
			39 01 00 00 00 00 02
			C8 1D 
			39 01 00 00 00 00 02
			C9 01 
			39 01 00 00 00 00 02
			CA 54 
			39 01 00 00 00 00 02
			CB 01 
			39 01 00 00 00 00 02
			CC 81 
			39 01 00 00 00 00 02
			CD 01 
			39 01 00 00 00 00 02
			CE CB 
			39 01 00 00 00 00 02
			CF 02 
			39 01 00 00 00 00 02
			D0 05 
			39 01 00 00 00 00 02
			D1 02 
			39 01 00 00 00 00 02
			D2 07 
			39 01 00 00 00 00 02
			D3 02 
			39 01 00 00 00 00 02
			D4 47 
			39 01 00 00 00 00 02
			D5 02 
			39 01 00 00 00 00 02
			D6 82 
			39 01 00 00 00 00 02
			D7 02 
			39 01 00 00 00 00 02
			D8 AB 
			39 01 00 00 00 00 02
			D9 02 
			39 01 00 00 00 00 02
			DA DC 
			39 01 00 00 00 00 02
			DB 03 
			39 01 00 00 00 00 02
			DC 01 
			39 01 00 00 00 00 02
			DD 03 
			39 01 00 00 00 00 02
			DE 3A 
			39 01 00 00 00 00 02
			DF 03 
			39 01 00 00 00 00 02
			E0 56 
			39 01 00 00 00 00 02
			E1 03 
			39 01 00 00 00 00 02
			E2 6D 
			39 01 00 00 00 00 02
			E3 03 
			39 01 00 00 00 00 02
			E4 89 
			39 01 00 00 00 00 02
			E5 03 
			39 01 00 00 00 00 02
			E6 A3 
			39 01 00 00 00 00 02
			E7 03 
			39 01 00 00 00 00 02
			E8 C9 
			39 01 00 00 00 00 02
			E9 03 
			39 01 00 00 00 00 02
			EA DD 
			39 01 00 00 00 00 02
			EB 03 
			39 01 00 00 00 00 02
			EC F5 
			39 01 00 00 00 00 02
			ED 03 
			39 01 00 00 00 00 02
			EE FF 
			39 01 00 00 00 00 02
			EF 00 
			39 01 00 00 00 00 02
			F0 00 
			39 01 00 00 00 00 02
			F1 00 
			39 01 00 00 00 00 02
			F2 22 
			39 01 00 00 00 00 02
			F3 00 
			39 01 00 00 00 00 02
			F4 46 
			39 01 00 00 00 00 02
			F5 00 
			39 01 00 00 00 00 02
			F6 5C 
			39 01 00 00 00 00 02
			F7 00 
			39 01 00 00 00 00 02
			F8 76 
			39 01 00 00 00 00 02
			F9 00 
			39 01 00 00 00 00 02
			FA 8D 
			39 01 00 00 01 00 02
			FF 21
			39 01 00 00 00 00 02
			FB 01 
			39 01 00 00 00 00 02
			00 00 
			39 01 00 00 00 00 02
			01 A6 
			39 01 00 00 00 00 02
			02 00 
			39 01 00 00 00 00 02
			03 B8 
			39 01 00 00 00 00 02
			04 00 
			39 01 00 00 00 00 02
			05 C7 
			39 01 00 00 00 00 02
			06 00 
			39 01 00 00 00 00 02
			07 F6 
			39 01 00 00 00 00 02
			08 01 
			39 01 00 00 00 00 02
			09 1D 
			39 01 00 00 00 00 02
			0A 01 
			39 01 00 00 00 00 02
			0B 54 
			39 01 00 00 00 00 02
			0C 01 
			39 01 00 00 00 00 02
			0D 81 
			39 01 00 00 00 00 02
			0E 01 
			39 01 00 00 00 00 02
			0F CB 
			39 01 00 00 00 00 02
			10 02 
			39 01 00 00 00 00 02
			11 05 
			39 01 00 00 00 00 02
			12 02 
			39 01 00 00 00 00 02
			13 07 
			39 01 00 00 00 00 02
			14 02 
			39 01 00 00 00 00 02
			15 47 
			39 01 00 00 00 00 02
			16 02 
			39 01 00 00 00 00 02
			17 82 
			39 01 00 00 00 00 02
			18 02 
			39 01 00 00 00 00 02
			19 AB 
			39 01 00 00 00 00 02
			1A 02 
			39 01 00 00 00 00 02
			1B DC 
			39 01 00 00 00 00 02
			1C 03 
			39 01 00 00 00 00 02
			1D 01 
			39 01 00 00 00 00 02
			1E 03 
			39 01 00 00 00 00 02
			1F 3A 
			39 01 00 00 00 00 02
			20 03 
			39 01 00 00 00 00 02
			21 56 
			39 01 00 00 00 00 02
			22 03 
			39 01 00 00 00 00 02
			23 6D 
			39 01 00 00 00 00 02
			24 03 
			39 01 00 00 00 00 02
			25 89 
			39 01 00 00 00 00 02
			26 03 
			39 01 00 00 00 00 02
			27 A3 
			39 01 00 00 00 00 02
			28 03 
			39 01 00 00 00 00 02
			29 C9 
			39 01 00 00 00 00 02
			2A 03 
			39 01 00 00 00 00 02
			2B DD 
			39 01 00 00 00 00 02
			2D 03 
			39 01 00 00 00 00 02
			2F F5 
			39 01 00 00 00 00 02
			30 03 
			39 01 00 00 00 00 02
			31 FF 
			39 01 00 00 00 00 02
			32 00 
			39 01 00 00 00 00 02
			33 00 
			39 01 00 00 00 00 02
			34 00 
			39 01 00 00 00 00 02
			35 22 
			39 01 00 00 00 00 02
			36 00 
			39 01 00 00 00 00 02
			37 46 
			39 01 00 00 00 00 02
			38 00 
			39 01 00 00 00 00 02
			39 5C 
			39 01 00 00 00 00 02
			3A 00 
			39 01 00 00 00 00 02
			3B 76 
			39 01 00 00 00 00 02
			3D 00 
			39 01 00 00 00 00 02
			3F 8D 
			39 01 00 00 00 00 02
			40 00 
			39 01 00 00 00 00 02
			41 A6 
			39 01 00 00 00 00 02
			42 00 
			39 01 00 00 00 00 02
			43 B8 
			39 01 00 00 00 00 02
			44 00 
			39 01 00 00 00 00 02
			45 C7 
			39 01 00 00 00 00 02
			46 00 
			39 01 00 00 00 00 02
			47 F6 
			39 01 00 00 00 00 02
			48 01 
			39 01 00 00 00 00 02
			49 1D 
			39 01 00 00 00 00 02
			4A 01 
			39 01 00 00 00 00 02
			4B 54 
			39 01 00 00 00 00 02
			4C 01 
			39 01 00 00 00 00 02
			4D 81 
			39 01 00 00 00 00 02
			4E 01 
			39 01 00 00 00 00 02
			4F CB 
			39 01 00 00 00 00 02
			50 02 
			39 01 00 00 00 00 02
			51 05 
			39 01 00 00 00 00 02
			52 02 
			39 01 00 00 00 00 02
			53 07 
			39 01 00 00 00 00 02
			54 02 
			39 01 00 00 00 00 02
			55 47 
			39 01 00 00 00 00 02
			56 02 
			39 01 00 00 00 00 02
			58 82 
			39 01 00 00 00 00 02
			59 02 
			39 01 00 00 00 00 02
			5A AB 
			39 01 00 00 00 00 02
			5B 02 
			39 01 00 00 00 00 02
			5C DC 
			39 01 00 00 00 00 02
			5D 03 
			39 01 00 00 00 00 02
			5E 01 
			39 01 00 00 00 00 02
			5F 03 
			39 01 00 00 00 00 02
			60 3A 
			39 01 00 00 00 00 02
			61 03 
			39 01 00 00 00 00 02
			62 56 
			39 01 00 00 00 00 02
			63 03 
			39 01 00 00 00 00 02
			64 6D 
			39 01 00 00 00 00 02
			65 03 
			39 01 00 00 00 00 02
			66 89 
			39 01 00 00 00 00 02
			67 03 
			39 01 00 00 00 00 02
			68 A3 
			39 01 00 00 00 00 02
			69 03 
			39 01 00 00 00 00 02
			6A C9 
			39 01 00 00 00 00 02
			6B 03 
			39 01 00 00 00 00 02
			6C DD 
			39 01 00 00 00 00 02
			6D 03 
			39 01 00 00 00 00 02
			6E F5 
			39 01 00 00 00 00 02
			6F 03 
			39 01 00 00 00 00 02
			70 FF 
			39 01 00 00 00 00 02
			71 00 
			39 01 00 00 00 00 02
			72 00 
			39 01 00 00 00 00 02
			73 00 
			39 01 00 00 00 00 02
			74 22 
			39 01 00 00 00 00 02
			75 00 
			39 01 00 00 00 00 02
			76 46 
			39 01 00 00 00 00 02
			77 00 
			39 01 00 00 00 00 02
			78 5C 
			39 01 00 00 00 00 02
			79 00 
			39 01 00 00 00 00 02
			7A 76 
			39 01 00 00 00 00 02
			7B 00 
			39 01 00 00 00 00 02
			7C 8D 
			39 01 00 00 00 00 02
			7D 00 
			39 01 00 00 00 00 02
			7E A6 
			39 01 00 00 00 00 02
			7F 00 
			39 01 00 00 00 00 02
			80 B8 
			39 01 00 00 00 00 02
			81 00 
			39 01 00 00 00 00 02
			82 C7 
			39 01 00 00 00 00 02
			83 00 
			39 01 00 00 00 00 02
			84 F6 
			39 01 00 00 00 00 02
			85 01 
			39 01 00 00 00 00 02
			86 1D 
			39 01 00 00 00 00 02
			87 01 
			39 01 00 00 00 00 02
			88 54 
			39 01 00 00 00 00 02
			89 01 
			39 01 00 00 00 00 02
			8A 81 
			39 01 00 00 00 00 02
			8B 01 
			39 01 00 00 00 00 02
			8C CB 
			39 01 00 00 00 00 02
			8D 02 
			39 01 00 00 00 00 02
			8E 05 
			39 01 00 00 00 00 02
			8F 02 
			39 01 00 00 00 00 02
			90 07 
			39 01 00 00 00 00 02
			91 02 
			39 01 00 00 00 00 02
			92 47 
			39 01 00 00 00 00 02
			93 02 
			39 01 00 00 00 00 02
			94 82 
			39 01 00 00 00 00 02
			95 02 
			39 01 00 00 00 00 02
			96 AB 
			39 01 00 00 00 00 02
			97 02 
			39 01 00 00 00 00 02
			98 DC 
			39 01 00 00 00 00 02
			99 03 
			39 01 00 00 00 00 02
			9A 01 
			39 01 00 00 00 00 02
			9B 03 
			39 01 00 00 00 00 02
			9C 3A 
			39 01 00 00 00 00 02
			9D 03 
			39 01 00 00 00 00 02
			9E 56 
			39 01 00 00 00 00 02
			9F 03 
			39 01 00 00 00 00 02
			A0 6D 
			39 01 00 00 00 00 02
			A2 03 
			39 01 00 00 00 00 02
			A3 89 
			39 01 00 00 00 00 02
			A4 03 
			39 01 00 00 00 00 02
			A5 A3 
			39 01 00 00 00 00 02
			A6 03 
			39 01 00 00 00 00 02
			A7 C9 
			39 01 00 00 00 00 02
			A9 03 
			39 01 00 00 00 00 02
			AA DD 
			39 01 00 00 00 00 02
			AB 03 
			39 01 00 00 00 00 02
			AC F5 
			39 01 00 00 00 00 02
			AD 03 
			39 01 00 00 00 00 02
			AE FF 
			39 01 00 00 00 00 02
			AF 00 
			39 01 00 00 00 00 02
			B0 00 
			39 01 00 00 00 00 02
			B1 00 
			39 01 00 00 00 00 02
			B2 22 
			39 01 00 00 00 00 02
			B3 00 
			39 01 00 00 00 00 02
			B4 46 
			39 01 00 00 00 00 02
			B5 00 
			39 01 00 00 00 00 02
			B6 5C 
			39 01 00 00 00 00 02
			B7 00 
			39 01 00 00 00 00 02
			B8 76 
			39 01 00 00 00 00 02
			B9 00 
			39 01 00 00 00 00 02
			BA 8D 
			39 01 00 00 00 00 02
			BB 00 
			39 01 00 00 00 00 02
			BC A6 
			39 01 00 00 00 00 02
			BD 00 
			39 01 00 00 00 00 02
			BE B8 
			39 01 00 00 00 00 02
			BF 00 
			39 01 00 00 00 00 02
			C0 C7 
			39 01 00 00 00 00 02
			C1 00 
			39 01 00 00 00 00 02
			C2 F6 
			39 01 00 00 00 00 02
			C3 01 
			39 01 00 00 00 00 02
			C4 1D 
			39 01 00 00 00 00 02
			C5 01 
			39 01 00 00 00 00 02
			C6 54 
			39 01 00 00 00 00 02
			C7 01 
			39 01 00 00 00 00 02
			C8 81 
			39 01 00 00 00 00 02
			C9 01 
			39 01 00 00 00 00 02
			CA CB 
			39 01 00 00 00 00 02
			CB 02 
			39 01 00 00 00 00 02
			CC 05 
			39 01 00 00 00 00 02
			CD 02 
			39 01 00 00 00 00 02
			CE 07 
			39 01 00 00 00 00 02
			CF 02 
			39 01 00 00 00 00 02
			D0 47 
			39 01 00 00 00 00 02
			D1 02 
			39 01 00 00 00 00 02
			D2 82 
			39 01 00 00 00 00 02
			D3 02 
			39 01 00 00 00 00 02
			D4 AB 
			39 01 00 00 00 00 02
			D5 02 
			39 01 00 00 00 00 02
			D6 DC 
			39 01 00 00 00 00 02
			D7 03 
			39 01 00 00 00 00 02
			D8 01 
			39 01 00 00 00 00 02
			D9 03 
			39 01 00 00 00 00 02
			DA 3A 
			39 01 00 00 00 00 02
			DB 03 
			39 01 00 00 00 00 02
			DC 56 
			39 01 00 00 00 00 02
			DD 03 
			39 01 00 00 00 00 02
			DE 6D 
			39 01 00 00 00 00 02
			DF 03 
			39 01 00 00 00 00 02
			E0 89 
			39 01 00 00 00 00 02
			E1 03 
			39 01 00 00 00 00 02
			E2 A3 
			39 01 00 00 00 00 02
			E3 03 
			39 01 00 00 00 00 02
			E4 C9 
			39 01 00 00 00 00 02
			E5 03 
			39 01 00 00 00 00 02
			E6 DD 
			39 01 00 00 00 00 02
			E7 03 
			39 01 00 00 00 00 02
			E8 F5 
			39 01 00 00 00 00 02
			E9 03 
			39 01 00 00 00 00 02
			EA FF 
			39 01 00 00 01 00 02
			FF 24
			39 01 00 00 00 00 02
			FB 01 
			39 01 00 00 00 00 02
			00 0F 
			39 01 00 00 00 00 02
			02 00 
			39 01 00 00 00 00 02
			03 00 
			39 01 00 00 00 00 02
			04 0B 
			39 01 00 00 00 00 02
			05 0C 
			39 01 00 00 00 00 02
			06 00 
			39 01 00 00 00 00 02
			07 00 
			39 01 00 00 00 00 02
			08 00 
			39 01 00 00 00 00 02
			09 00 
			39 01 00 00 00 00 02
			0A 03 
			39 01 00 00 00 00 02
			0B 04 
			39 01 00 00 00 00 02
			0C 01 
			39 01 00 00 00 00 02
			0D 13 
			39 01 00 00 00 00 02
			0E 15 
			39 01 00 00 00 00 02
			0F 17 
			39 01 00 00 00 00 02
			10 0F 
			39 01 00 00 00 00 02
			12 00 
			39 01 00 00 00 00 02
			13 00 
			39 01 00 00 00 00 02
			14 0B 
			39 01 00 00 00 00 02
			15 0C 
			39 01 00 00 00 00 02
			16 00 
			39 01 00 00 00 00 02
			17 00 
			39 01 00 00 00 00 02
			18 00 
			39 01 00 00 00 00 02
			19 00 
			39 01 00 00 00 00 02
			1A 03 
			39 01 00 00 00 00 02
			1B 04 
			39 01 00 00 00 00 02
			1C 01 
			39 01 00 00 00 00 02
			1D 13 
			39 01 00 00 00 00 02
			1E 15 
			39 01 00 00 00 00 02
			1F 17 
			39 01 00 00 00 00 02
			20 09 
			39 01 00 00 00 00 02
			21 01 
			39 01 00 00 00 00 02
			22 00 
			39 01 00 00 00 00 02
			23 00 
			39 01 00 00 00 00 02
			24 00 
			39 01 00 00 00 00 02
			25 6D 
			39 01 00 00 00 00 02
			26 00 
			39 01 00 00 00 00 02
			27 00 
			39 01 00 00 00 00 02
			29 58 
			39 01 00 00 00 00 02
			2A 16 
			39 01 00 00 00 00 02
			2F 02 
			39 01 00 00 00 00 02
			30 04 
			39 01 00 00 00 00 02
			31 49 
			39 01 00 00 00 00 02
			32 23 
			39 01 00 00 00 00 02
			33 01 
			39 01 00 00 00 00 02
			34 01 
			39 01 00 00 00 00 02
			35 6E 
			39 01 00 00 00 00 02
			36 00 
			39 01 00 00 00 00 02
			37 2D 
			39 01 00 00 00 00 02
			38 08 
			39 01 00 00 00 00 02
			39 01 
			39 01 00 00 00 00 02
			3A 6E 
			39 01 00 00 00 00 02
			3B 00 
			39 01 00 00 00 00 02
			59 02 
			39 01 00 00 00 00 02
			5A 08 
			39 01 00 00 00 00 02
			5B 00 
			39 01 00 00 00 00 02
			5F 75 
			39 01 00 00 00 00 02
			63 00 
			39 01 00 00 00 00 02
			67 04 
			39 01 00 00 00 00 02
			5C 05 
			39 01 00 00 00 00 02
			60 75 
			39 01 00 00 00 00 02
			64 01 
			39 01 00 00 00 00 02
			68 04 
			39 01 00 00 00 00 02
			6E 10 
			39 01 00 00 00 00 02
			72 00 
			39 01 00 00 00 00 02
			73 00 
			39 01 00 00 00 00 02
			74 11 
			39 01 00 00 00 00 02
			75 1A 
			39 01 00 00 00 00 02
			76 06 
			39 01 00 00 00 00 02
			77 03 
			39 01 00 00 00 00 02
			78 00 
			39 01 00 00 00 00 02
			79 00 
			39 01 00 00 00 00 02
			7A 00 
			39 01 00 00 00 00 02
			7B 80 
			39 01 00 00 00 00 02
			7C D8 
			39 01 00 00 00 00 02
			7D 60 
			39 01 00 00 00 00 02
			7E 11 
			39 01 00 00 00 00 02
			7F 1A 
			39 01 00 00 00 00 02
			80 00 
			39 01 00 00 00 00 02
			81 06 
			39 01 00 00 00 00 02
			82 03 
			39 01 00 00 00 00 02
			83 00 
			39 01 00 00 00 00 02
			84 03 
			39 01 00 00 00 00 02
			85 07 
			39 01 00 00 00 00 02
			86 1B 
			39 01 00 00 00 00 02
			87 39 
			39 01 00 00 00 00 02
			88 1B 
			39 01 00 00 00 00 02
			89 39 
			39 01 00 00 00 00 02
			8A 33 
			39 01 00 00 00 00 02
			8B F4 
			39 01 00 00 00 00 02
			8C 01 
			39 01 00 00 00 00 02
			8E 02 
			39 01 00 00 00 00 02
			90 95 
			39 01 00 00 00 00 02
			91 C8 
			39 01 00 00 00 00 02
			92 95 
			39 01 00 00 00 00 02
			93 02 
			39 01 00 00 00 00 02
			94 08 
			39 01 00 00 00 00 02
			95 2B 
			39 01 00 00 00 00 02
			96 95 
			39 01 00 00 00 00 02
			98 00 
			39 01 00 00 00 00 02
			99 33 
			39 01 00 00 00 00 02
			9A 03 
			39 01 00 00 00 00 02
			9B 0F 
			39 01 00 00 00 00 02
			9C 01 
			39 01 00 00 00 00 02
			9D B0 
			39 01 00 00 00 00 02
			A0 33 
			39 01 00 00 00 00 02
			A6 03 
			39 01 00 00 00 00 02
			DE FF 
			39 01 00 00 00 00 02
			B3 28 
			39 01 00 00 00 00 02
			B4 05 
			39 01 00 00 00 00 02
			B5 10 
			39 01 00 00 00 00 02
			C2 80 
			39 01 00 00 00 00 02
			C3 10 
			39 01 00 00 00 00 02
			C4 24 
			39 01 00 00 00 00 02
			C5 30 
			39 01 00 00 00 00 02
			C6 00
			39 01 00 00 00 00 02
			D1 00
			39 01 00 00 00 00 02
			D2 00
			39 01 00 00 01 00 02
			FF 10
			39 01 00 00 00 00 06
			3B 03 08 02 04 04
			//MIPI CMD Mode=10  Video Mode=03
			39 01 00 00 00 00 02
			BB 03
			39 01 00 00 00 00 02
			FB 01
			39 01 00 00 00 00 02
			51 FF
			39 01 00 00 00 00 02
			53 2C
			39 01 00 00 00 00 02
			55 01
			39 01 00 00 00 00 02
			5E 06
			39 01 00 00 00 00 02
			35 00

			//bist mode
			//39 01 00 00 00 00 02
			//FF 24
			//39 01 00 00 00 00 02
			//EC 01
			//39 01 00 00 00 00 02
			//FF 10
			05 01 00 00 78 00 02
			11 00
			05 01 00 00 00 00 02
			29 00
					];
		qcom,mdss-dsi-off-command = [
			05 01 00 00 32 00 02
			28 00
			05 01 00 00 78 00 02
			10 00
					];
		qcom,mdss-dsi-on-command-state = "dsi_lp_mode";
		qcom,mdss-dsi-off-command-state = "dsi_lp_mode";
		qcom,mdss-dsi-h-sync-pulse = <0>;
		qcom,mdss-dsi-traffic-mode = "non_burst_sync_pulse";
		qcom,mdss-dsi-lane-map = "lane_map_0123";
		qcom,mdss-dsi-bllp-eof-power-mode;
		qcom,mdss-dsi-bllp-power-mode;
		qcom,mdss-dsi-lane-0-state;
		qcom,mdss-dsi-lane-1-state;
		qcom,mdss-dsi-lane-2-state;
		qcom,mdss-dsi-lane-3-state;
		qcom,mdss-dsi-panel-timings = [76 38 26 00 68 6e 2a 3c 2c 03 04 00];
		//qcom,mdss-dsi-panel-timings = [e7 36 24 00 68 6a 2a 3a 2d 03 04 00];
		qcom,mdss-dsi-t-clk-post = <0x04>;
		qcom,mdss-dsi-t-clk-pre = <0x1b>;
		qcom,mdss-dsi-bl-min-level = <1>;
		qcom,mdss-dsi-bl-max-level = <4095>;
		qcom,mdss-dsi-dma-trigger = "trigger_sw";
		qcom,mdss-dsi-mdp-trigger = "none";
		qcom,mdss-dsi-bl-pmic-control-type = "bl_ctrl_pwm";
		qcom,mdss-dsi-bl-pmic-pwm-frequency = <100>;
		qcom,mdss-dsi-bl-pmic-bank-select = <0>;
		qcom,mdss-dsi-pwm-gpio = <&pm8916_mpps 4 0>;
		qcom,mdss-dsi-reset-sequence = <1 20>, <0 10>, <1 20>;

		//add lcd esd
		//qcom,mdss-dsi-panel-status-command = [06 01 00 01 05 00 02 0A 08];
		//qcom,mdss-dsi-panel-status-command-state = "dsi_lp_mode";
		//qcom,mdss-dsi-panel-status-check-mode = "reg_read";
		//qcom,mdss-dsi-panel-status-value = <0x9c>;
		//qcom,esd-check-enabled;
		//esd end
	};
};
