/* Copyright (c) 2013, The Linux Foundation. All rights reserved.
 *
 * This program is free software; you can redistribute it and/or modify
 * it under the terms of the GNU General Public License version 2 and
 * only version 2 as published by the Free Software Foundation.
 *
 * This program is distributed in the hope that it will be useful,
 * but WITHOUT ANY WARRANTY; without even the implied warranty of
 * MERCHANTABILITY or FITNESS FOR A PARTICULAR PURPOSE.  See the
 * GNU General Public License for more details.
 */

/*---------------------------------------------------------------------------
 * This file is autogenerated file using gcdb parser. Please do not edit it.
 * Update input XML file to add a new entry or update variable in this file
 * VERSION = "1.0"
 *---------------------------------------------------------------------------*/
&mdss_mdp {
	dsi_eR63422_truly_1080p_cmd: qcom,mdss_dsi_eR63422_truly_1080p_cmd {
		qcom,mdss-dsi-panel-name = "eR63422_truly_1080p_cmd_mode_dsi_panel";
		qcom,mdss-dsi-panel-controller = <&mdss_dsi0>;
		qcom,mdss-dsi-panel-type = "dsi_cmd_mode";
		qcom,mdss-dsi-panel-destination = "display_1";
		qcom,mdss-dsi-panel-framerate = <60>;
		qcom,mdss-dsi-virtual-channel-id = <0>;
		qcom,mdss-dsi-stream = <0>;
		qcom,mdss-pan-physical-width-dimension = <68>;
		qcom,mdss-pan-physical-height-dimension = <121>;
		qcom,mdss-dsi-panel-width = <1080>;
		qcom,mdss-dsi-panel-height = <1920>;
		qcom,mdss-dsi-h-front-porch = <60>;
		qcom,mdss-dsi-h-back-porch = <80>;
		qcom,mdss-dsi-h-pulse-width = <10>;
		qcom,mdss-dsi-h-sync-skew = <0>;
		qcom,mdss-dsi-v-back-porch = <12>;
		qcom,mdss-dsi-v-front-porch = <8>;
		qcom,mdss-dsi-v-pulse-width = <2>;
		qcom,mdss-dsi-h-left-border = <0>;
		qcom,mdss-dsi-h-right-border = <0>;
		qcom,mdss-dsi-v-top-border = <0>;
		qcom,mdss-dsi-v-bottom-border = <0>;
		qcom,mdss-dsi-bpp = <24>;
		qcom,mdss-dsi-color-order = "rgb_swap_rgb";
		qcom,mdss-dsi-underflow-color = <0xff>;
		qcom,mdss-dsi-border-color = <0>;
		qcom,mdss-dsi-on-command = [29 01 00 00 00 00 02 B0 04
				29 01 00 00 00 00 05 B3 04 02 00 00
				29 01 00 00 00 00 04 B6 3A D3 00
				29 01 00 00 00 00 24 C1 84 60 10 F1 FF CF DA FF FF 9F 12 E4 A4 74 4A 40 CC FF FF 37 F6 FF 8F 10 10 10 10 00 02 01 02 02 11 00 01
				29 01 00 00 00 00 09 C2 31 F7 80 08 08 00 08 00
				29 01 00 00 00 00 04 C3 00 00 00
				29 01 00 00 00 00 1D C4 70 00 00 00 00 00 00 00 00 00 00 0C 06 00 70 00 00 00 00 00 00 00 00 00 00 0C 06 00
				29 01 00 00 00 00 2B C6 78 08 67 08 67 00 00 00 00 00 00 00 00 00 00 00 00 16 18 08 C8 78 08 67 08 67 00 00 00 00 00 00 00 00 00 00 00 00 16 18 08 C8
				29 01 00 00 00 00 1F C7 00 10 18 21 2E 3C 47 54 39 40 4B 58 64 6C 71 00 10 18 21 2E 3C 46 56 3A 41 4D 59 64 6C 71
				29 01 00 00 00 00 14 C8 00 00 00 00 00 FC 00 00 00 00 00 FC 00 00 00 00 00 FC 00
				29 01 00 00 00 00 0F CB 31 FC 3F 8C 00 00 00 00 00 00 00 00 E0 00
				29 01 00 00 00 00 02 CC 0B
				29 01 00 00 00 00 05 D0 91 99 18 FD
				29 01 00 00 00 00 11 D2 8A 34 34 33 12 33 33 33 77 77 33 33 33 00 00 00
				29 01 00 00 00 00 08 D5 06 00 00 01 43 01 43
				29 01 00 00 00 00 05 E5 00 3F FF 10
				29 01 00 00 00 00 02 D6 01
				15 01 00 00 00 00 02 36 00
				15 01 00 00 00 00 02 3A 77
				05 01 00 00 12 00 01 29
				05 01 00 00 78 00 01 11];
		qcom,mdss-dsi-off-command = [29 01 00 00 00 00 08 D5 06 00 00 00 48 00 48
				29 01 00 00 00 00 08 D5 06 00 00 00 48 00 48
				05 01 00 00 12 00 01 28
				05 01 00 00 78 00 01 10];
		qcom,mdss-dsi-on-command-state = "dsi_lp_mode";
		qcom,mdss-dsi-off-command-state = "dsi_lp_mode";
		qcom,mdss-dsi-h-sync-pulse = <1>;
		qcom,mdss-dsi-traffic-mode = "burst_mode";
		qcom,mdss-dsi-lane-map = "lane_map_0123";
		qcom,mdss-dsi-bllp-eof-power-mode;
		qcom,mdss-dsi-bllp-power-mode;
		qcom,cont-splash-enabled;
		//qcom,esd-check-enabled;
		qcom,mdss-dsi-lane-0-state;
		qcom,mdss-dsi-lane-1-state;
		qcom,mdss-dsi-lane-2-state;
		qcom,mdss-dsi-lane-3-state;
		qcom,mdss-dsi-te-pin-select = <1>;
		qcom,mdss-dsi-wr-mem-start = <0x2c>;
		qcom,mdss-dsi-wr-mem-continue = <0x3c>;
		qcom,mdss-dsi-te-dcs-command = <1>;
		qcom,mdss-dsi-te-check-enable;
		qcom,mdss-dsi-te-using-te-pin;
		qcom,mdss-dsi-panel-timings = [e7 36 24 00 66 6a 2a 3a 2d 03 04 00];
		qcom,mdss-dsi-panel-status-command = [06 01 00 01 05 00 02 0A 08];
		qcom,mdss-dsi-panel-status-command-state ="dsi_lp_mode";
		qcom,mdss-dsi-panel-status-check-mode = "reg_read";
		qcom,mdss-dsi-panel-status-value = <0x1c>;
		// qcom,mdss-dsi-panel-status-check-mode = "bta_check";
		qcom,mdss-dsi-t-clk-post = <0x02>;
		qcom,mdss-dsi-t-clk-pre = <0x2b>;
		qcom,mdss-dsi-bl-min-level = <1>;
		qcom,mdss-dsi-bl-max-level = <4095>;
		qcom,mdss-dsi-bl-pmic-pwm-frequency = <100>;
		qcom,mdss-dsi-bl-pmic-bank-select = <0>;
		qcom,mdss-dsi-dma-trigger = "trigger_sw";
		qcom,mdss-dsi-mdp-trigger = "none";
		qcom,mdss-dsi-panel-clockrate = <788000000>;
		qcom,mdss-dsi-bl-pmic-control-type = "bl_ctrl_pwm";
		qcom,mdss-dsi-reset-sequence = <1 10>, <0 10>, <1 10>;
	};
};
