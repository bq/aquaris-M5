/* Copyright (c) 2013-2015, The Linux Foundation. All rights reserved.
 *
 * This program is free software; you can redistribute it and/or modify
 * it under the terms of the GNU General Public License version 2 and
 * only version 2 as published by the Free Software Foundation.
 *
 * This program is distributed in the hope that it will be useful,
 * but WITHOUT ANY WARRANTY; without even the implied warranty of
 * MERCHANTABILITY or FITNESS FOR A PARTICULAR PURPOSE.  See the
 * GNU General Public License for more details.
 */

/*---------------------------------------------------------------------------
 * This file is autogenerated file using gcdb parser. Please do not edit it.
 * Update input XML file to add a new entry or update variable in this file
 * VERSION = "1.0"
 *---------------------------------------------------------------------------*/
&mdss_mdp {
	dsi_yushun_nt35695_1080p_cmd_vid: qcom,mdss_dsi_yushun_nt35695_1080p_cmd {
		qcom,mdss-dsi-panel-name = "szsucess(yushun) NT35695 1080P command mode dsi panel";
		qcom,mdss-dsi-panel-controller = <&mdss_dsi0>;
		qcom,mdss-dsi-panel-type = "dsi_cmd_mode";
		qcom,mdss-dsi-panel-destination = "display_1";
		qcom,cont-splash-enabled;
		qcom,mdss-dsi-panel-framerate = <60>;
		qcom,mdss-dsi-virtual-channel-id = <0>;
		qcom,mdss-dsi-stream = <0>;
		qcom,mdss-dsi-panel-width = <1080>;
		qcom,mdss-dsi-panel-height = <1920>;
		qcom,mdss-dsi-h-front-porch = <120>;
		qcom,mdss-dsi-h-back-porch = <90>;
		qcom,mdss-dsi-h-pulse-width = <20>;
		qcom,mdss-dsi-h-sync-skew = <0>;
		qcom,mdss-dsi-v-front-porch = <20>;
		qcom,mdss-dsi-v-back-porch = <8>;
		qcom,mdss-dsi-v-pulse-width = <2>;
		qcom,mdss-dsi-h-left-border = <0>;
		qcom,mdss-dsi-h-right-border = <0>;
		qcom,mdss-dsi-v-top-border = <0>;
		qcom,mdss-dsi-v-bottom-border = <0>;
		qcom,mdss-dsi-bpp = <24>;
		qcom,mdss-dsi-color-order = "rgb_swap_rgb";
		qcom,mdss-dsi-underflow-color = <0xff>;
		qcom,mdss-dsi-border-color = <0>;
		qcom,mdss-pan-physical-width-dimension = <62>; //the panel physical size : refer to datasheet
		qcom,mdss-pan-physical-height-dimension = <110>;
		qcom,mdss-dsi-on-command = [
			39 01 00 00 01 00 02
			FF 20
			39 01 00 00 00 00 02
			FB 01 
			39 01 00 00 00 00 02
			00 01  
			39 01 00 00 00 00 02
			01 55 
			39 01 00 00 00 00 02
			02 45 
			39 01 00 00 00 00 02
			03 55 
			39 01 00 00 00 00 02
			05 50 
			39 01 00 00 00 00 02
			04 00 
			39 01 00 00 00 00 02
			06 9E 
			39 01 00 00 00 00 02
			07 A8 
			39 01 00 00 00 00 02
			08 0C 
			39 01 00 00 00 00 02
			09 55
			39 01 00 00 00 00 02
			0A 55
			39 01 00 00 00 00 02
			0D 00 
			39 01 00 00 00 00 02
			0B 55
			39 01 00 00 00 00 02
			0C 55
			39 01 00 00 00 00 02
			0E 00 
			39 01 00 00 00 00 02
			0F 00 
			39 01 00 00 00 00 02
			11 27 
			39 01 00 00 00 00 02
			12 63 
			39 01 00 00 00 00 02
			13 F3 
			39 01 00 00 00 00 02
			14 4A 
			39 01 00 00 00 00 02
			15 93 
			39 01 00 00 00 00 02
			16 93 
			39 01 00 00 00 00 02
			17 63 
			39 01 00 00 00 00 02
			18 63 
			39 01 00 00 00 00 02
			19 63 
			39 01 00 00 00 00 02
			1A 63 
			39 01 00 00 00 00 02
			68 03 
			39 01 00 00 00 00 02
			69 A0 
			39 01 00 00 00 00 02
			6A 33 
			39 01 00 00 00 00 02
			6B 40 
			39 01 00 00 00 00 02
			6C 33 
			39 01 00 00 00 00 02
			6D 68 
			39 01 00 00 00 00 02
			75 00
			39 01 00 00 00 00 02
			76 00
			39 01 00 00 00 00 02
			77 00
			39 01 00 00 00 00 02
			78 08
			39 01 00 00 00 00 02
			79 00
			39 01 00 00 00 00 02
			7A 19
			39 01 00 00 00 00 02
			7B 00
			39 01 00 00 00 00 02
			7C 29
			39 01 00 00 00 00 02
			7D 00
			39 01 00 00 00 00 02
			7E 39
			39 01 00 00 00 00 02
			7F 00
			39 01 00 00 00 00 02
			80 48
			39 01 00 00 00 00 02
			81 00
			39 01 00 00 00 00 02
			82 56
			39 01 00 00 00 00 02
			83 00
			39 01 00 00 00 00 02
			84 63
			39 01 00 00 00 00 02
			85 00
			39 01 00 00 00 00 02
			86 71
			39 01 00 00 00 00 02
			87 00
			39 01 00 00 00 00 02
			88 9f
			39 01 00 00 00 00 02
			89 00
			39 01 00 00 00 00 02
			8A C7
			39 01 00 00 00 00 02
			8B 01
			39 01 00 00 00 00 02
			8C 08
			39 01 00 00 00 00 02
			8D 01
			39 01 00 00 00 00 02
			8E 3B
			39 01 00 00 00 00 02
			8F 01
			39 01 00 00 00 00 02
			90 8D
			39 01 00 00 00 00 02
			91 01
			39 01 00 00 00 00 02
			92 D0
			39 01 00 00 00 00 02
			93 01
			39 01 00 00 00 00 02
			94 D2
			39 01 00 00 00 00 02
			95 02
			39 01 00 00 00 00 02
			96 11
			39 01 00 00 00 00 02
			97 02
			39 01 00 00 00 00 02
			98 57
			39 01 00 00 00 00 02
			99 02
			39 01 00 00 00 00 02
			9A 83
			39 01 00 00 00 00 02
			9B 02
			39 01 00 00 00 00 02
			9C BE
			39 01 00 00 00 00 02
			9D 02
			39 01 00 00 00 00 02
			9E E6
			39 01 00 00 00 00 02
			9F 03
			39 01 00 00 00 00 02
			A0 14
			39 01 00 00 00 00 02
			A2 03
			39 01 00 00 00 00 02
			A3 27
			39 01 00 00 00 00 02
			A4 03
			39 01 00 00 00 00 02
			A5 39
			39 01 00 00 00 00 02
			A6 03
			39 01 00 00 00 00 02
			A7 4B
			39 01 00 00 00 00 02
			A9 03
			39 01 00 00 00 00 02
			AA 5D
			39 01 00 00 00 00 02
			AB 03
			39 01 00 00 00 00 02
			AC 71
			39 01 00 00 00 00 02
			AD 03
			39 01 00 00 00 00 02
			AE 84
			39 01 00 00 00 00 02
			AF 03
			39 01 00 00 00 00 02
			B0 93
			39 01 00 00 00 00 02
			B1 03
			39 01 00 00 00 00 02
			B2 CD
			39 01 00 00 00 00 02
			B3 00
			39 01 00 00 00 00 02
			B4 00
			39 01 00 00 00 00 02
			B5 00
			39 01 00 00 00 00 02
			B6 08
			39 01 00 00 00 00 02
			B7 00
			39 01 00 00 00 00 02
			B8 19
			39 01 00 00 00 00 02
			B9 00
			39 01 00 00 00 00 02
			BA 29
			39 01 00 00 00 00 02
			BB 00
			39 01 00 00 00 00 02
			BC 39
			39 01 00 00 00 00 02
			BD 00
			39 01 00 00 00 00 02
			BE 48
			39 01 00 00 00 00 02
			BF 00
			39 01 00 00 00 00 02
			C0 56
			39 01 00 00 00 00 02
			C1 00
			39 01 00 00 00 00 02
			C2 63
			39 01 00 00 00 00 02
			C3 00
			39 01 00 00 00 00 02
			C4 71
			39 01 00 00 00 00 02
			C5 00
			39 01 00 00 00 00 02
			C6 9F
			39 01 00 00 00 00 02
			C7 00
			39 01 00 00 00 00 02
			C8 C7
			39 01 00 00 00 00 02
			C9 01
			39 01 00 00 00 00 02
			CA 08
			39 01 00 00 00 00 02
			CB 01
			39 01 00 00 00 00 02
			CC 3B
			39 01 00 00 00 00 02
			CD 01
			39 01 00 00 00 00 02
			CE 8D
			39 01 00 00 00 00 02
			CF 01
			39 01 00 00 00 00 02
			D0 D0
			39 01 00 00 00 00 02
			D1 01
			39 01 00 00 00 00 02
			D2 D2
			39 01 00 00 00 00 02
			D3 02
			39 01 00 00 00 00 02
			D4 11
			39 01 00 00 00 00 02
			D5 02
			39 01 00 00 00 00 02
			D6 57
			39 01 00 00 00 00 02
			D7 02
			39 01 00 00 00 00 02
			D8 83
			39 01 00 00 00 00 02
			D9 02
			39 01 00 00 00 00 02
			DA BE
			39 01 00 00 00 00 02
			DB 02
			39 01 00 00 00 00 02
			DC E6
			39 01 00 00 00 00 02
			DD 03
			39 01 00 00 00 00 02
			DE 14
			39 01 00 00 00 00 02
			DF 03
			39 01 00 00 00 00 02
			E0 27
			39 01 00 00 00 00 02
			E1 03
			39 01 00 00 00 00 02
			E2 39
			39 01 00 00 00 00 02
			E3 03
			39 01 00 00 00 00 02
			E4 4B
			39 01 00 00 00 00 02
			E5 03
			39 01 00 00 00 00 02
			E6 5D
			39 01 00 00 00 00 02
			E7 03
			39 01 00 00 00 00 02
			E8 71
			39 01 00 00 00 00 02
			E9 03
			39 01 00 00 00 00 02
			EA 84
			39 01 00 00 00 00 02
			EB 03
			39 01 00 00 00 00 02
			EC 93
			39 01 00 00 00 00 02
			ED 03
			39 01 00 00 00 00 02
			EE CD
			39 01 00 00 00 00 02
			EF 00
			39 01 00 00 00 00 02
			F0 00
			39 01 00 00 00 00 02
			F1 00
			39 01 00 00 00 00 02
			F2 08
			39 01 00 00 00 00 02
			F3 00
			39 01 00 00 00 00 02
			F4 19
			39 01 00 00 00 00 02
			F5 00
			39 01 00 00 00 00 02
			F6 29
			39 01 00 00 00 00 02
			F7 00
			39 01 00 00 00 00 02
			F8 39
			39 01 00 00 00 00 02
			F9 00
			39 01 00 00 00 00 02
			FA 48
			39 01 00 00 01 00 02
			FF 21
			39 01 00 00 00 00 02
			FB 01 
			39 01 00 00 00 00 02
			00 00
			39 01 00 00 00 00 02
			01 56
			39 01 00 00 00 00 02
			02 00
			39 01 00 00 00 00 02
			03 63
			39 01 00 00 00 00 02
			04 00
			39 01 00 00 00 00 02
			05 71
			39 01 00 00 00 00 02
			06 00
			39 01 00 00 00 00 02
			07 9F
			39 01 00 00 00 00 02
			08 00
			39 01 00 00 00 00 02
			09 C7
			39 01 00 00 00 00 02
			0A 01
			39 01 00 00 00 00 02
			0B 08
			39 01 00 00 00 00 02
			0C 01
			39 01 00 00 00 00 02
			0D 3B
			39 01 00 00 00 00 02
			0E 01
			39 01 00 00 00 00 02
			0F 8D
			39 01 00 00 00 00 02
			10 01
			39 01 00 00 00 00 02
			11 D0
			39 01 00 00 00 00 02
			12 01
			39 01 00 00 00 00 02
			13 D2
			39 01 00 00 00 00 02
			14 02
			39 01 00 00 00 00 02
			15 11
			39 01 00 00 00 00 02
			16 02
			39 01 00 00 00 00 02
			17 57
			39 01 00 00 00 00 02
			18 02
			39 01 00 00 00 00 02
			19 83
			39 01 00 00 00 00 02
			1A 02
			39 01 00 00 00 00 02
			1B BE
			39 01 00 00 00 00 02
			1C 02
			39 01 00 00 00 00 02
			1D E6
			39 01 00 00 00 00 02
			1E 03
			39 01 00 00 00 00 02
			1F 14
			39 01 00 00 00 00 02
			20 03
			39 01 00 00 00 00 02
			21 27
			39 01 00 00 00 00 02
			22 03
			39 01 00 00 00 00 02
			23 39
			39 01 00 00 00 00 02
			24 03
			39 01 00 00 00 00 02
			25 4B
			39 01 00 00 00 00 02
			26 03
			39 01 00 00 00 00 02
			27 5D
			39 01 00 00 00 00 02
			28 03
			39 01 00 00 00 00 02
			29 71
			39 01 00 00 00 00 02
			2A 03
			39 01 00 00 00 00 02
			2B 84
			39 01 00 00 00 00 02
			2D 03
			39 01 00 00 00 00 02
			2F 93
			39 01 00 00 00 00 02
			30 03
			39 01 00 00 00 00 02
			31 CD
			39 01 00 00 00 00 02
			32 00
			39 01 00 00 00 00 02
			33 00
			39 01 00 00 00 00 02
			34 00
			39 01 00 00 00 00 02
			35 08
			39 01 00 00 00 00 02
			36 00
			39 01 00 00 00 00 02
			37 19
			39 01 00 00 00 00 02
			38 00
			39 01 00 00 00 00 02
			39 29
			39 01 00 00 00 00 02
			3A 00
			39 01 00 00 00 00 02
			3B 39
			39 01 00 00 00 00 02
			3D 00
			39 01 00 00 00 00 02
			3F 48
			39 01 00 00 00 00 02
			40 00
			39 01 00 00 00 00 02
			41 56
			39 01 00 00 00 00 02
			42 00
			39 01 00 00 00 00 02
			43 63
			39 01 00 00 00 00 02
			44 00
			39 01 00 00 00 00 02
			45 71
			39 01 00 00 00 00 02
			46 00
			39 01 00 00 00 00 02
			47 9F
			39 01 00 00 00 00 02
			48 00
			39 01 00 00 00 00 02
			49 C7
			39 01 00 00 00 00 02
			4A 01
			39 01 00 00 00 00 02
			4B 08
			39 01 00 00 00 00 02
			4C 01
			39 01 00 00 00 00 02
			4D 3B
			39 01 00 00 00 00 02
			4E 01
			39 01 00 00 00 00 02
			4F 8D
			39 01 00 00 00 00 02
			50 01
			39 01 00 00 00 00 02
			51 D0
			39 01 00 00 00 00 02
			52 01
			39 01 00 00 00 00 02
			53 D2
			39 01 00 00 00 00 02
			54 02
			39 01 00 00 00 00 02
			55 11
			39 01 00 00 00 00 02
			56 02
			39 01 00 00 00 00 02
			58 57
			39 01 00 00 00 00 02
			59 02
			39 01 00 00 00 00 02
			5A 83
			39 01 00 00 00 00 02
			5B 02
			39 01 00 00 00 00 02
			5C BE
			39 01 00 00 00 00 02
			5D 02
			39 01 00 00 00 00 02
			5E E6
			39 01 00 00 00 00 02
			5F 03
			39 01 00 00 00 00 02
			60 14
			39 01 00 00 00 00 02
			61 03
			39 01 00 00 00 00 02
			62 27
			39 01 00 00 00 00 02
			63 03
			39 01 00 00 00 00 02
			64 39
			39 01 00 00 00 00 02
			65 03
			39 01 00 00 00 00 02
			66 4B
			39 01 00 00 00 00 02
			67 03
			39 01 00 00 00 00 02
			68 5D
			39 01 00 00 00 00 02
			69 03
			39 01 00 00 00 00 02
			6A 71
			39 01 00 00 00 00 02
			6B 03
			39 01 00 00 00 00 02
			6C 84
			39 01 00 00 00 00 02
			6D 03
			39 01 00 00 00 00 02
			6E 93
			39 01 00 00 00 00 02
			6F 03
			39 01 00 00 00 00 02
			70 CD
			39 01 00 00 00 00 02
			71 00
			39 01 00 00 00 00 02
			72 00
			39 01 00 00 00 00 02
			73 00
			39 01 00 00 00 00 02
			74 08
			39 01 00 00 00 00 02
			75 00
			39 01 00 00 00 00 02
			76 19
			39 01 00 00 00 00 02
			77 00
			39 01 00 00 00 00 02
			78 29
			39 01 00 00 00 00 02
			79 00
			39 01 00 00 00 00 02
			7A 39
			39 01 00 00 00 00 02
			7B 00
			39 01 00 00 00 00 02
			7C 48
			39 01 00 00 00 00 02
			7D 00
			39 01 00 00 00 00 02
			7E 56
			39 01 00 00 00 00 02
			7F 00
			39 01 00 00 00 00 02
			80 63
			39 01 00 00 00 00 02
			81 00
			39 01 00 00 00 00 02
			82 71
			39 01 00 00 00 00 02
			83 00
			39 01 00 00 00 00 02
			84 9F
			39 01 00 00 00 00 02
			85 00
			39 01 00 00 00 00 02
			86 C7
			39 01 00 00 00 00 02
			87 01
			39 01 00 00 00 00 02
			88 08
			39 01 00 00 00 00 02
			89 01
			39 01 00 00 00 00 02
			8A 3B
			39 01 00 00 00 00 02
			8B 01
			39 01 00 00 00 00 02
			8C 8D
			39 01 00 00 00 00 02
			8D 01
			39 01 00 00 00 00 02
			8E D0
			39 01 00 00 00 00 02
			8F 01
			39 01 00 00 00 00 02
			90 D2
			39 01 00 00 00 00 02
			91 02
			39 01 00 00 00 00 02
			92 11
			39 01 00 00 00 00 02
			93 02
			39 01 00 00 00 00 02
			94 57
			39 01 00 00 00 00 02
			95 02
			39 01 00 00 00 00 02
			96 83
			39 01 00 00 00 00 02
			97 02
			39 01 00 00 00 00 02
			98 BE
			39 01 00 00 00 00 02
			99 02
			39 01 00 00 00 00 02
			9A E6
			39 01 00 00 00 00 02
			9B 03
			39 01 00 00 00 00 02
			9C 14
			39 01 00 00 00 00 02
			9D 03
			39 01 00 00 00 00 02
			9E 27
			39 01 00 00 00 00 02
			9F 03
			39 01 00 00 00 00 02
			A0 39
			39 01 00 00 00 00 02
			A2 03
			39 01 00 00 00 00 02
			A3 4B
			39 01 00 00 00 00 02
			A4 03
			39 01 00 00 00 00 02
			A5 5D
			39 01 00 00 00 00 02
			A6 03
			39 01 00 00 00 00 02
			A7 71
			39 01 00 00 00 00 02
			A9 03
			39 01 00 00 00 00 02
			AA 84
			39 01 00 00 00 00 02
			AB 03
			39 01 00 00 00 00 02
			AC 93
			39 01 00 00 00 00 02
			AD 03
			39 01 00 00 00 00 02
			AE CD
			39 01 00 00 00 00 02
			AF 00
			39 01 00 00 00 00 02
			B0 00
			39 01 00 00 00 00 02
			B1 00
			39 01 00 00 00 00 02
			B2 08
			39 01 00 00 00 00 02
			B3 00
			39 01 00 00 00 00 02
			B4 19
			39 01 00 00 00 00 02
			B5 00
			39 01 00 00 00 00 02
			B6 29
			39 01 00 00 00 00 02
			B7 00
			39 01 00 00 00 00 02
			B8 39
			39 01 00 00 00 00 02
			B9 00
			39 01 00 00 00 00 02
			BA 48
			39 01 00 00 00 00 02
			BB 00
			39 01 00 00 00 00 02
			BC 56
			39 01 00 00 00 00 02
			BD 00
			39 01 00 00 00 00 02
			BE 63
			39 01 00 00 00 00 02
			BF 00
			39 01 00 00 00 00 02
			C0 71
			39 01 00 00 00 00 02
			C1 00
			39 01 00 00 00 00 02
			C2 9F
			39 01 00 00 00 00 02
			C3 00
			39 01 00 00 00 00 02
			C4 C7
			39 01 00 00 00 00 02
			C5 01
			39 01 00 00 00 00 02
			C6 08
			39 01 00 00 00 00 02
			C7 01
			39 01 00 00 00 00 02
			C8 3B
			39 01 00 00 00 00 02
			C9 01
			39 01 00 00 00 00 02
			CA 8D
			39 01 00 00 00 00 02
			CB 01
			39 01 00 00 00 00 02
			CC D0
			39 01 00 00 00 00 02
			CD 01
			39 01 00 00 00 00 02
			CE D2
			39 01 00 00 00 00 02
			CF 02
			39 01 00 00 00 00 02
			D0 11
			39 01 00 00 00 00 02
			D1 02
			39 01 00 00 00 00 02
			D2 57
			39 01 00 00 00 00 02
			D3 02
			39 01 00 00 00 00 02
			D4 83
			39 01 00 00 00 00 02
			D5 02
			39 01 00 00 00 00 02
			D6 BE
			39 01 00 00 00 00 02
			D7 02
			39 01 00 00 00 00 02
			D8 E6
			39 01 00 00 00 00 02
			D9 03
			39 01 00 00 00 00 02
			DA 14
			39 01 00 00 00 00 02
			DB 03
			39 01 00 00 00 00 02
			DC 27
			39 01 00 00 00 00 02
			DD 03
			39 01 00 00 00 00 02
			DE 39
			39 01 00 00 00 00 02
			DF 03
			39 01 00 00 00 00 02
			E0 4B
			39 01 00 00 00 00 02
			E1 03
			39 01 00 00 00 00 02
			E2 5D
			39 01 00 00 00 00 02
			E3 03
			39 01 00 00 00 00 02
			E4 71
			39 01 00 00 00 00 02
			E5 03
			39 01 00 00 00 00 02
			E6 84
			39 01 00 00 00 00 02
			E7 03
			39 01 00 00 00 00 02
			E8 93
			39 01 00 00 00 00 02
			E9 03
			39 01 00 00 00 00 02
			EA CD
			39 01 00 00 01 00 02
			FF 24
			39 01 00 00 00 00 02
			FB 01 
			39 01 00 00 00 00 02
			00 0F 
			39 01 00 00 00 00 02
			02 00 
			39 01 00 00 00 00 02
			03 00 
			39 01 00 00 00 00 02
			04 0B 
			39 01 00 00 00 00 02
			05 0C 
			39 01 00 00 00 00 02
			06 00 
			39 01 00 00 00 00 02
			07 00 
			39 01 00 00 00 00 02
			08 00 
			39 01 00 00 00 00 02
			09 00 
			39 01 00 00 00 00 02
			0A 03 
			39 01 00 00 00 00 02
			0B 04 
			39 01 00 00 00 00 02
			0C 01 
			39 01 00 00 00 00 02
			0D 13 
			39 01 00 00 00 00 02
			0E 15 
			39 01 00 00 00 00 02
			0F 17 
			39 01 00 00 00 00 02
			10 0F 
			39 01 00 00 00 00 02
			12 00 
			39 01 00 00 00 00 02
			13 00 
			39 01 00 00 00 00 02
			14 0B 
			39 01 00 00 00 00 02
			15 0C 
			39 01 00 00 00 00 02
			16 00 
			39 01 00 00 00 00 02
			17 00 
			39 01 00 00 00 00 02
			18 00 
			39 01 00 00 00 00 02
			19 00 
			39 01 00 00 00 00 02
			1A 03 
			39 01 00 00 00 00 02
			1B 04 
			39 01 00 00 00 00 02
			1C 01 
			39 01 00 00 00 00 02
			1D 13 
			39 01 00 00 00 00 02
			1E 15 
			39 01 00 00 00 00 02
			1F 17 
			39 01 00 00 00 00 02
			20 09 
			39 01 00 00 00 00 02
			21 01 
			39 01 00 00 00 00 02
			22 00 
			39 01 00 00 00 00 02
			23 00 
			39 01 00 00 00 00 02
			24 00 
			39 01 00 00 00 00 02
			25 6D 
			39 01 00 00 00 00 02
			26 00 
			39 01 00 00 00 00 02
			27 00 
			39 01 00 00 00 00 02
			29 58 
			39 01 00 00 00 00 02
			2A 16 
			39 01 00 00 00 00 02
			2F 02 
			39 01 00 00 00 00 02
			30 04 
			39 01 00 00 00 00 02
			31 49 
			39 01 00 00 00 00 02
			32 23 
			39 01 00 00 00 00 02
			33 01 
			39 01 00 00 00 00 02
			34 01 
			39 01 00 00 00 00 02
			35 6E 
			39 01 00 00 00 00 02
			36 00 
			39 01 00 00 00 00 02
			37 2D 
			39 01 00 00 00 00 02
			38 08 
			39 01 00 00 00 00 02
			39 01 
			39 01 00 00 00 00 02
			3A 6E 
			39 01 00 00 00 00 02
			3B 00 
			39 01 00 00 00 00 02
			59 02 
			39 01 00 00 00 00 02
			5A 08 
			39 01 00 00 00 00 02
			5B 00 
			39 01 00 00 00 00 02
			5F 75 
			39 01 00 00 00 00 02
			63 00 
			39 01 00 00 00 00 02
			67 04 
			39 01 00 00 00 00 02
			5C 05 
			39 01 00 00 00 00 02
			60 75 
			39 01 00 00 00 00 02
			64 01 
			39 01 00 00 00 00 02
			68 04 
			39 01 00 00 00 00 02
			6E 10 
			39 01 00 00 00 00 02
			72 00 
			39 01 00 00 00 00 02
			73 00 
			39 01 00 00 00 00 02
			74 11 
			39 01 00 00 00 00 02
			75 1A 
			39 01 00 00 00 00 02
			76 06 
			39 01 00 00 00 00 02
			77 03 
			39 01 00 00 00 00 02
			78 00 
			39 01 00 00 00 00 02
			79 00 
			39 01 00 00 00 00 02
			7A 00 
			39 01 00 00 00 00 02
			7B 80 
			39 01 00 00 00 00 02
			7C D8 
			39 01 00 00 00 00 02
			7D 60 
			39 01 00 00 00 00 02
			7E 11 
			39 01 00 00 00 00 02
			7F 1A 
			39 01 00 00 00 00 02
			80 00 
			39 01 00 00 00 00 02
			81 06 
			39 01 00 00 00 00 02
			82 03 
			39 01 00 00 00 00 02
			83 00 
			39 01 00 00 00 00 02
			84 03 
			39 01 00 00 00 00 02
			85 07 
			39 01 00 00 00 00 02
			86 1B 
			39 01 00 00 00 00 02
			87 39 
			39 01 00 00 00 00 02
			88 1B 
			39 01 00 00 00 00 02
			89 39 
			39 01 00 00 00 00 02
			8A 33 
			39 01 00 00 00 00 02
			8B F4 
			39 01 00 00 00 00 02
			8C 01 
			39 01 00 00 00 00 02
			8E 02 
			39 01 00 00 00 00 02
			90 95 
			39 01 00 00 00 00 02
			91 C8 
			39 01 00 00 00 00 02
			92 95 
			39 01 00 00 00 00 02
			93 02 
			39 01 00 00 00 00 02
			94 08 
			39 01 00 00 00 00 02
			95 2B 
			39 01 00 00 00 00 02
			96 95 
			39 01 00 00 00 00 02
			98 00 
			39 01 00 00 00 00 02
			99 33 
			39 01 00 00 00 00 02
			9A 03 
			39 01 00 00 00 00 02
			9B 0F 
			39 01 00 00 00 00 02
			9C 01 
			39 01 00 00 00 00 02
			9D B0 
			39 01 00 00 00 00 02
			A0 33 
			39 01 00 00 00 00 02
			A6 03 
			39 01 00 00 00 00 02
			DE FF 
			39 01 00 00 00 00 02
			B3 28 
			39 01 00 00 00 00 02
			B4 05 
			39 01 00 00 00 00 02
			B5 10 
			39 01 00 00 00 00 02
			C2 80 
			39 01 00 00 00 00 02
			C3 10 
			39 01 00 00 00 00 02
			C4 24 
			39 01 00 00 00 00 02
			C5 30 
			39 01 00 00 00 00 02
			C6 00
			39 01 00 00 00 00 02
			D1 00
			39 01 00 00 00 00 02
			D2 00
			39 01 00 00 01 00 02
			FF 10
			39 01 00 00 00 00 06
			3B 03 08 02 04 04
			//MIPI CMD Mode=10  Video Mode=03
			39 01 00 00 00 00 02
			BB 10
			39 01 00 00 00 00 02
			FB 01
			39 01 00 00 00 00 02
			51 FF
			39 01 00 00 00 00 02
			53 2C
			39 01 00 00 00 00 02
			55 01
			39 01 00 00 00 00 02
			5E 06
			39 01 00 00 00 00 02
			35 00
			39 01 00 00 00 00 03
			44 05 00

			//bist mode
			//39 01 00 00 00 00 02
			//FF 24
			//39 01 00 00 00 00 02
			//EC 01
			//39 01 00 00 00 00 02
			//FF 10
			05 01 00 00 78 00 02
			11 00
			05 01 00 00 00 00 02
			29 00
					];
		qcom,mdss-dsi-off-command = [
			05 01 00 00 32 00 02
			28 00
			05 01 00 00 78 00 02
			10 00
			39 01 00 00 00 00 02
			4F 01
			39 01 00 00 00 00 02
			FF 24
			39 01 00 00 00 00 02
			FB 01
			39 01 00 00 00 00 02
			6E 10
					];
		qcom,mdss-dsi-on-command-state = "dsi_lp_mode";
		qcom,mdss-dsi-off-command-state = "dsi_lp_mode";
		qcom,mdss-dsi-h-sync-pulse = <0>;
		qcom,mdss-dsi-traffic-mode = "non_burst_sync_pulse";
		qcom,mdss-dsi-lane-map = "lane_map_0123";
		qcom,mdss-dsi-bllp-eof-power-mode;
		qcom,mdss-dsi-bllp-power-mode;
		qcom,mdss-dsi-lane-0-state;
		qcom,mdss-dsi-lane-1-state;
		qcom,mdss-dsi-lane-2-state;
		qcom,mdss-dsi-lane-3-state;
		qcom,mdss-dsi-panel-timings = [e7 3a 26 00 6a 6e 2c 3e 2f 03 04 00];
		qcom,mdss-dsi-t-clk-post = <0x1e>;
		qcom,mdss-dsi-t-clk-pre = <0x1b>;
		qcom,mdss-dsi-bl-min-level = <161>;
		qcom,mdss-dsi-bl-max-level = <4095>;
		qcom,mdss-dsi-dma-trigger = "trigger_sw";
		qcom,mdss-dsi-mdp-trigger = "none";
		qcom,mdss-dsi-bl-pmic-control-type = "bl_ctrl_pwm";
		qcom,mdss-dsi-bl-pmic-pwm-frequency = <100>;
		qcom,mdss-dsi-bl-pmic-bank-select = <0>;
		qcom,mdss-dsi-pwm-gpio = <&pm8916_mpps 4 0>;
		qcom,mdss-dsi-reset-sequence = <1 20>, <0 10>, <1 20>;

		//cmd mode : set TE
		qcom,mdss-dsi-te-pin-select = <1>;
		qcom,mdss-dsi-te-dcs-command = <1>;
		qcom,mdss-dsi-te-check-enable;
		qcom,mdss-dsi-te-using-te-pin;
		//TE end

		//add lcd esd
		//qcom,mdss-dsi-panel-status-command = [06 01 00 01 05 00 02 0A 08];
		//qcom,mdss-dsi-panel-status-command-state = "dsi_lp_mode";
		//qcom,mdss-dsi-panel-status-check-mode = "reg_read";
		//qcom,mdss-dsi-panel-status-value = <0x9c>;
		//qcom,esd-check-enabled;
		//esd end
	};
};
