/* Copyright (c) 2013, The Linux Foundation. All rights reserved.
 *
 * This program is free software; you can redistribute it and/or modify
 * it under the terms of the GNU General Public License version 2 and
 * only version 2 as published by the Free Software Foundation.
 *
 * This program is distributed in the hope that it will be useful,
 * but WITHOUT ANY WARRANTY; without even the implied warranty of
 * MERCHANTABILITY or FITNESS FOR A PARTICULAR PURPOSE.  See the
 * GNU General Public License for more details.
 */

/*---------------------------------------------------------------------------
 * This file is autogenerated file using gcdb parser. Please do not edit it.
 * Update input XML file to add a new entry or update variable in this file
 * VERSION = "1.0"
 *---------------------------------------------------------------------------*/
&mdss_mdp {
	dsi_tianma_otm1902a_1080p_cmd_vid: qcom,mdss_dsi_tianma_otm1902a_1080p_cmd {
		qcom,mdss-dsi-panel-name = "TIANMA OTM1902A 1080P command mode dsi panel";
		qcom,mdss-dsi-panel-controller = <&mdss_dsi0>;
		qcom,mdss-dsi-panel-type = "dsi_cmd_mode";
		qcom,mdss-dsi-panel-destination = "display_1";
		qcom,cont-splash-enabled;
		qcom,mdss-dsi-panel-framerate = <60>;
		qcom,mdss-dsi-virtual-channel-id = <0>;
		qcom,mdss-dsi-stream = <0>;
		qcom,mdss-dsi-panel-width = <1080>;
		qcom,mdss-dsi-panel-height = <1920>;
		qcom,mdss-dsi-h-front-porch = <90>;
		qcom,mdss-dsi-h-back-porch = <60>;
		qcom,mdss-dsi-h-pulse-width = <20>;
		qcom,mdss-dsi-h-sync-skew = <0>;
		qcom,mdss-dsi-v-front-porch = <9>;
		qcom,mdss-dsi-v-back-porch = <2>;
		qcom,mdss-dsi-v-pulse-width = <2>;
		qcom,mdss-dsi-h-left-border = <0>;
		qcom,mdss-dsi-h-right-border = <0>;
		qcom,mdss-dsi-v-top-border = <0>;
		qcom,mdss-dsi-v-bottom-border = <0>;
		qcom,mdss-dsi-bpp = <24>;
		qcom,mdss-dsi-color-order = "rgb_swap_rgb";
		qcom,mdss-dsi-underflow-color = <0xff>;
		qcom,mdss-dsi-border-color = <0>;
		qcom,mdss-pan-physical-width-dimension = <62>; //the panel physical size : refer to datasheet
		qcom,mdss-pan-physical-height-dimension = <110>;
		qcom,mdss-dsi-on-command = [
			39 01 00 00 00 00 02
			00 00
			39 01 00 00 00 00 04
			FF 19 02 01
			39 01 00 00 00 00 02
			00 80
			39 01 00 00 00 00 03
			FF 19 02
			39 01 00 00 00 00 02
			00 00
			39 01 00 00 00 00 02
			1C 00
			39 01 00 00 00 00 02
			00 90 
			39 01 00 00 00 00 02
			B4 09
			39 01 00 00 00 00 02
			00 80
			39 01 00 00 00 00 03
			C1 11 11
			39 01 00 00 00 00 02
			00 90
			39 01 00 00 00 00 03
			C1 44 00
			39 01 00 00 00 00 02
			00 80
			39 01 00 00 00 00 0F
			C0 00 7E 00 0A 0A 00 7E 06 05 00 7E 00 0A 0A
			39 01 00 00 00 00 02
			00 80
			39 01 00 00 00 00 04
			A5 0C 00 0F	
			39 01 00 00 00 00 02
			00 F8
			39 01 00 00 00 00 07
			C2 82 00 00 0C 01 01
			39 01 00 00 00 00 02
			00 FB
			39 01 00 00 00 00 02
			C2 00
			39 01 00 00 00 00 02
			00 A0
			39 01 00 00 00 00 0E
			C0 00 00 00 15 02 15 05 00 00 FF FF 00 00
			39 01 00 00 00 00 02
			00 B3
			39 01 00 00 00 00 02
			C0 CC
			39 01 00 00 00 00 02
			00 B4
			39 01 00 00 00 00 02
			C0 40 
			39 01 00 00 00 00 02
			00 EA
			39 01 00 00 00 00 03
			C2 22 00
			39 01 00 00 00 00 02
			00 D0
			39 01 00 00 00 00 0E
			C0 00 00 00 12 01 1A 05 00 00 FF FF 00 00
			39 01 00 00 00 00 02
			00 80
			39 01 00 00 00 00 09
			C2 82 01 00 0E 83 00 1D 00
			39 01 00 00 00 00 02
			00 90
			39 01 00 00 00 00 10
			C2 82 80 01 0D 00 81 00 01 0D 00 80 00 01 0D 00
			39 01 00 00 00 00 02
			00 A0
			39 01 00 00 00 00 10
			C2 01 01 01 0D 00 82 00 00 00 8E 81 02 00 00 8E
			39 01 00 00 00 00 02
			00 B0
			39 01 00 00 00 00 0B
			C2 82 03 01 00 8E 82 03 01 00 8E
			39 01 00 00 00 00 02
			00 C0
			39 01 00 00 00 00 0E
			C1 00 00 00 00 00 00 00 00 00 11 11 11 11
			39 01 00 00 00 00 02
			00 C0
			39 01 00 00 00 00 0B
			C2 00 01 03 00 00 01 02 03 00 00
			39 01 00 00 00 00 02
			00 D0
			39 01 00 00 00 00 0B
			C2 82 81 03 00 00 81 80 03 00 00
			39 01 00 00 00 00 02
			00 E0
			39 01 00 00 00 00 0B
			C2 81 5F 01 00 1F 81 5F 01 00 1F
			39 01 00 00 00 00 02
			00 EC
			39 01 00 00 00 00 03
			C2 10 00
			39 01 00 00 00 00 02
			00 E0
			39 01 00 00 00 00 0D
			C1 80 74 01 01 09 81 74 01 01 09 01 01
			39 01 00 00 00 00 02
			00 F0
			39 01 00 00 00 00 09
			C2 00 00 00 00 00 00 00 00
			39 01 00 00 00 00 02
			00 80
			39 01 00 00 00 00 0E
			CB F0 0F 00 FF 00 33 00 00 00 00 00 00 00 
			39 01 00 00 00 00 02
			00 90
			39 01 00 00 00 00 10
			CB 00 00 00 00 00 00 00 00 00 00 00 00 00 00 00
			39 01 00 00 00 00 02
			00 A0
			39 01 00 00 00 00 10
			CB 00 00 00 00 00 00 00 00 00 F0 00 00 00 00 00
			39 01 00 00 00 00 02
			00 B0
			39 01 00 00 00 00 10
			CB 00 00 00 00 00 00 00 00 00 00 50 50 40 00 00
			39 01 00 00 00 00 02
			00 EB
			39 01 00 00 00 00 03
			CC F0 00
			39 01 00 00 00 00 02
			00 C0
			39 01 00 00 00 00 10
			CB 00 00 D4 D4 D4 D4 00 00 00 00 00 00 D4 D4 D4
			39 01 00 00 00 00 02
			00 D0
			39 01 00 00 00 00 10
			CB D4 28 28 28 28 D4 14 E8 28 37 04 04 04 04 04
			39 01 00 00 00 00 02
			00 E0
			39 01 00 00 00 00 10
			CB 04 04 04 04 04 04 04 04 04 04 05 05 05 04 00
			39 01 00 00 00 00 02
			00 ED
			39 01 00 00 00 00 03
			CC FF 00
			39 01 00 00 00 00 02
			00 F0
			39 01 00 00 00 00 0D
			CB F0 0F 00 FF 00 F3 03 00 00 00 00 00
			39 01 00 00 00 00 02
			00 E0
			39 01 00 00 00 00 07
			CC 00 00 00 00 00 40
			39 01 00 00 00 00 02
			00 80
			39 01 00 00 00 00 0D
			CC 2E 0F 03 04 05 06 07 08 05 0A 10 2F
			39 01 00 00 00 00 02
			00 B0
			39 01 00 00 00 00 0D
			CC 2F 10 06 05 04 03 07 08 09 0A 0F 2E
			39 01 00 00 00 00 02
			00 80
			39 01 00 00 00 00 10
			CD 13 14 15 12 13 14 15 12 01 2D 2D 02 17 26 18
			39 01 00 00 00 00 02
			00 90
			39 01 00 00 00 00 10
			CD 19 1A 1B 1C 1D 1E 1F 20 21 22 23 24 25 27 28
			39 01 00 00 00 00 02
			00 E6
			39 01 00 00 00 00 06
			CC 29 2A 11 11 11
			39 01 00 00 00 00 02
			00 A0
			39 01 00 00 00 00 10
			CD 2F 2F 2F 2F 2F 2F 2F 2F 2F 2F 2F 2F 2F 2F 03
			39 01 00 00 00 00 02
			00 B0
			39 01 00 00 00 00 10
			CD 05 2F 18 16 17 15 2F 12 11 14 0E 0D 10 2F 2F
			39 01 00 00 00 00 02
			00 C0
			39 01 00 00 00 00 0F
			CD 2F 2F 2F 2F 2F 2F 2F 2F 2F 2F 2F 2F 2F 2F
			39 01 00 00 00 00 02
			00 D0
			39 01 00 00 00 00 10
			CD 2F 2F 2F 2F 2F 2F 2F 2F 2F 2F 2F 2F 2F 2F 04
			39 01 00 00 00 00 02
			00 E0
			39 01 00 00 00 00 10
			CD 06 2F 18 16 17 15 2F 12 11 14 0E 0D 10 2F 2F
			39 01 00 00 00 00 02
			00 F0
			39 01 00 00 00 00 0F
			CD 2F 2F 2F 2F 2F 2F 2F 2F 2F 2F 2F 2F 2F 2F
			39 01 00 00 00 00 02
			00 80
			39 01 00 00 00 00 09
			C3 82 01 00 0E 83 00 1D 00
			39 01 00 00 00 00 02
			00 90
			39 01 00 00 00 00 10
			C3 82 80 01 0D 00 81 00 01 0D 00 80 00 01 0D 00
			39 01 00 00 00 00 02
			00 A0
			39 01 00 00 00 00 10
			C3 01 01 01 0D 00 82 00 00 00 8E 81 02 00 00 8E
			39 01 00 00 00 00 02
			00 B0
			39 01 00 00 00 00 0B
			C3 82 03 01 00 8E 82 03 01 00 8E
			39 01 00 00 00 00 02
			00 D0
			39 01 00 00 00 00 0E
			C1 00 00 00 00 00 00 00 00 00 11 11 11 11
			39 01 00 00 00 00 02
			00 C0
			39 01 00 00 00 00 0B
			C3 00 01 03 00 00 01 02 03 00 00
			39 01 00 00 00 00 02
			00 D0
			39 01 00 00 00 00 0B
			C3 82 81 03 00 00 81 80 03 00 00
			39 01 00 00 00 00 02
			00 E0
			39 01 00 00 00 00 0B
			C3 81 5F 01 00 1A 81 5F 01 00 1A
			39 01 00 00 00 00 02
			00 EC
			39 01 00 00 00 00 03
			C3 10 00
			39 01 00 00 00 00 02
			00 F0
			39 01 00 00 00 00 0B
			C1 80 74 01 01 09 81 74 01 01 09
			39 01 00 00 00 00 02
			00 80
			39 01 00 00 00 00 06
			C4 18 2C 00 20 00
			39 01 00 00 00 00 02
			00 A0
			39 01 00 00 00 00 0A
			C4 30 06 04 3A 30 26 84 3A 11
			39 01 00 00 00 00 02
			00 90
			39 01 00 00 00 00 0F
			C5 92 16 A0 28 D0 1E 80 18 80 1E 44 44 40 88
			39 01 00 00 00 00 02
			00 A0
			39 01 00 00 00 00 0F
			C5 92 16 A0 14 A0 1E 80 14 80 32 44 44 40 88
			39 01 00 00 00 00 02
			00 C0
			39 01 00 00 00 00 04
			C5 12 FA 08
			39 01 00 00 00 00 02
			00 00
			39 01 00 00 00 00 03
			C6 00 00
			39 01 00 00 00 00 02
			00 B0
			39 01 00 00 00 00 05
			CA 10 20 5F 50
			39 01 00 00 00 00 02
			00 00
			39 01 00 00 00 00 03
			D8 26 26
			39 01 00 00 00 00 02
			00 00
			39 01 00 00 00 00 02
			D9 85
			39 01 00 00 00 00 02
			00 83
			39 01 00 00 00 00 02
			F3 CA
			39 01 00 00 00 00 02
			00 90
			39 01 00 00 00 00 02
			C4 00
			39 01 00 00 00 00 02
			00 C4
			39 01 00 00 00 00 02
			C5 04
			39 01 00 00 00 00 02
			00 B6
			39 01 00 00 00 00 02
			C0 7F
			39 01 00 00 00 00 02
			00 A0
			39 01 00 00 00 00 09
			C1 00 ED 00 00 00 00 00 02
			39 01 00 00 00 00 02
			00 91
			39 01 00 00 00 00 02
			E9 00
			39 01 00 00 00 00 02
			00 BA
			39 01 00 00 00 00 03
			F5 80 80
			39 01 00 00 00 00 02
			00 A5
			39 01 00 00 00 00 02
			B3 80
			39 01 00 00 00 00 02
			00 00
			39 01 00 00 00 00 19
			E1 00 09 11 1c 25 2b 37 49 54 66 73 7e 79 71 68 58 45 34 28 22 1a 11 0c 03
			39 01 00 00 00 00 02
			00 00
			39 01 00 00 00 00 19
			E2 00 09 11 1c 25 2b 37 49 54 66 73 7e 79 71 68 58 45 34 28 22 1a 11 0c 03
			39 01 00 00 00 00 02
			00 00
			39 01 00 00 00 00 19
			E3 46 48 4a 4e 51 53 59 63 68 73 7c 84 74 6d 65 55 43 32 27 21 19 10 0b 03
			39 01 00 00 00 00 02
			00 00
			39 01 00 00 00 00 19
			E4 46 48 4a 4e 51 53 59 63 68 73 7c 84 74 6d 65 55 43 32 27 21 19 10 0b 03
			39 01 00 00 00 00 02
			00 00
			39 01 00 00 00 00 19
			E5 34 37 39 3e 43 47 4e 59 61 6e 79 82 76 6e 65 54 42 31 26 20 18 10 0b 03
			39 01 00 00 00 00 02
			00 00
			39 01 00 00 00 00 19
			E6 34 37 39 3e 43 47 4e 59 61 6e 79 82 76 6e 65 54 42 31 26 20 18 10 0b 03

			05 01 00 00 78 00 02
			11 00
			05 01 00 00 00 00 02
			29 00
					];
		qcom,mdss-dsi-off-command = [
			05 01 00 00 32 00 02
			28 00
			05 01 00 00 78 00 02
			10 00
					];
		qcom,mdss-dsi-on-command-state = "dsi_lp_mode";
		qcom,mdss-dsi-off-command-state = "dsi_lp_mode";
		qcom,mdss-dsi-h-sync-pulse = <0>;
		qcom,mdss-dsi-traffic-mode = "non_burst_sync_pulse";
		qcom,mdss-dsi-lane-map = "lane_map_0123";
		qcom,mdss-dsi-bllp-eof-power-mode;
		qcom,mdss-dsi-bllp-power-mode;
		qcom,mdss-dsi-lane-0-state;
		qcom,mdss-dsi-lane-1-state;
		qcom,mdss-dsi-lane-2-state;
		qcom,mdss-dsi-lane-3-state;
		qcom,mdss-dsi-panel-timings = [76 38 26 00 68 6e 2a 3c 2c 03 04 00];
		//qcom,mdss-dsi-panel-timings = [e7 36 24 00 68 6a 2a 3a 2d 03 04 00];
		qcom,mdss-dsi-t-clk-post = <0x1e>;
		qcom,mdss-dsi-t-clk-pre = <0x1b>;
		qcom,mdss-dsi-bl-min-level = <1>;
		qcom,mdss-dsi-bl-max-level = <4095>;
		qcom,mdss-dsi-dma-trigger = "trigger_sw";
		qcom,mdss-dsi-mdp-trigger = "none";
		qcom,mdss-dsi-bl-pmic-control-type = "bl_ctrl_pwm";
		qcom,mdss-dsi-bl-pmic-pwm-frequency = <100>;
		qcom,mdss-dsi-bl-pmic-bank-select = <0>;
		qcom,mdss-dsi-pwm-gpio = <&pm8916_mpps 4 0>;
		qcom,mdss-dsi-reset-sequence = <1 20>, <0 10>, <1 20>;

		//cmd mode : set TE
		qcom,mdss-dsi-te-pin-select = <1>;
		qcom,mdss-dsi-te-dcs-command = <1>;
		qcom,mdss-dsi-te-check-enable;
		qcom,mdss-dsi-te-using-te-pin;
		//qcom,partial-update-enabled;    //it will cause confusion screen:remove the function : part brush pitcture
		//TE end

		//add lcd esd
		//qcom,mdss-dsi-panel-status-command = [06 01 00 01 05 00 02 0A 08];
		//qcom,mdss-dsi-panel-status-command-state = "dsi_lp_mode";
		//qcom,mdss-dsi-panel-status-check-mode = "reg_read";
		//qcom,mdss-dsi-panel-status-value = <0x9c>;
		//qcom,esd-check-enabled;
		//esd end
	};
};
